## Kconfig
```kconfig
#
# For a description of the syntax of this configuration file,
# see kconfig-language at https://www.kernel.org/doc/Documentation/kbuild/kconfig-language.txt
#

config LIB_MBEDTLS
	bool "The mbed tls library support"
	select DEV_URANDOM
	default n
	---help---
		Enable support for the mbed tls library

if LIB_MBEDTLS

config LIB_MBEDTLS_VERSION
  string "The mbed tls library version"
  default "master"
  help
    This module describes mbedtls version information.

config MBEDTLS_DEBUG_C
  bool "This module provides debugging functions."
  default n
  help
    This module provides debugging functions.

config MBEDTLS_SSL_MAX_CONTENT_LEN
  int "Maximum length (in bytes) of incoming and outgoing plaintext fragments."
  default 16384
  help
    Maximum length (in bytes) of incoming and outgoing plaintext fragments.

config MBEDTLS_SSL_SRV_C
  bool "This module is required for SSL/TLS server support."
  default n
  help
    This module is required for SSL/TLS server support.

config MBEDTLS_PLATFORM_MEMORY
  bool "Enable the memory allocation layer."
  default n
  help

config MBEDTLS_ENTROPY_HARDWARE_ALT
  bool "Uncomment this macro to let mbed TLS use your own implementation of a hardware entropy collector."
  default n
  help

config MBEDTLS_AES_ROM_TABLES
  bool "Store the AES tables in ROM."
  default n
  help

config MBEDTLS_REMOVE_ARC4_CIPHERSUITES
  bool "Remove RC4 ciphersuites by default in SSL / TLS."
  default y
  help

config MBEDTLS_NO_PLATFORM_ENTROPY
  bool "Do not use built-in platform entropy functions."
  default y if DEV_URANDOM
  default n
  help

config MBEDTLS_SELF_TEST
  bool "Enable the checkup functions (*_self_test)."
  default n
  help

config MBEDTLS_SSL_DTLS_CLIENT_PORT_REUSE
  bool "Enable server-side support for clients that reconnect from the same port."
  default y
  help

config MBEDTLS_BLOWFISH_C
  bool "Enable the Blowfish block cipher."
  default y
  help

config MBEDTLS_CAMELLIA_C
  bool "Enable the Camellia block cipher."
  default y
  help

config MBEDTLS_CERTS_C
  bool "Enable the test certificates."
  default y
  help

config MBEDTLS_PADLOCK_C
  bool "Enable VIA Padlock support on x86."
  default y
  help

config MBEDTLS_TIMING_C
  bool "Enable the semi-portable timing interface."
  default y
  help

if ARCH_BOARD_AMEBAZ

config MBEDTLS_AMEBAZ_HARDWARE_CRYPTO
  bool "Enable the amebaZ hardware crypto."
  default n
  help
    This module is enable the amebaZ hardware crypto.

endif

endif
```

## library/Kconfig
```kconfig
#
# For a description of the syntax of this configuration file,
# see kconfig-language at https://www.kernel.org/doc/Documentation/kbuild/kconfig-language.txt
#

config LIB_MBEDTLS
	bool "The mbed tls library support"
	select DEV_URANDOM
	default n
	---help---
		Enable support for the mbed tls library

if LIB_MBEDTLS

config MBEDTLS_DEBUG_C
  bool "This module provides debugging functions."
  default n
  help
    This module provides debugging functions.

config MBEDTLS_SSL_MAX_CONTENT_LEN
  int "Maximum length (in bytes) of incoming and outgoing plaintext fragments."
  default 16384
  help
    Maximum length (in bytes) of incoming and outgoing plaintext fragments.

config MBEDTLS_SSL_SRV_C
  bool "This module is required for SSL/TLS server support."
  default n
  help
    This module is required for SSL/TLS server support.

endif
```
